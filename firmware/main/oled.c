/* SSD1306 / SH1106 128x64 OLED, bit-banged I2C (see oled.h). */
#include "oled.h"
#include <stdint.h>
#include <string.h>
#include "driver/gpio.h"
#include "esp_rom_sys.h"

static uint8_t addr;                                             /* 7-bit address; 0: no display */

/* ------------------------------------------------------------ I2C, open drain: level 1 releases the line to the pull-up */

#define I2C_HALF_US 2                                            /* about 200 kHz */

static inline void sda(int v) { gpio_set_level(OLED_SDA_GPIO, v); }
static inline void scl(int v) { gpio_set_level(OLED_SCL_GPIO, v); esp_rom_delay_us(I2C_HALF_US); }

static void i2c_start(void) { sda(1); scl(1); sda(0); esp_rom_delay_us(I2C_HALF_US); scl(0); }
static void i2c_stop(void) { sda(0); scl(1); sda(1); esp_rom_delay_us(I2C_HALF_US); }

void (*oled_byte_hook)(void);

static bool i2c_byte(uint8_t b) {                                /* true: ACK */
    for (int i = 7; i >= 0; --i) {
        sda((b >> i) & 1);
        scl(1);
        scl(0);
    }
    sda(1);
    scl(1);
    const bool ack = gpio_get_level(OLED_SDA_GPIO) == 0;
    scl(0);
    if (oled_byte_hook) oled_byte_hook();
    return ack;
}

static bool cmds(const uint8_t *c, size_t n) {
    i2c_start();
    bool ok = i2c_byte(addr << 1) && i2c_byte(0x00);             /* control byte: commands follow */
    for (size_t i = 0; ok && i < n; ++i) ok = i2c_byte(c[i]);
    i2c_stop();
    return ok;
}

/* ------------------------------------------------------------ 5x7 font, ASCII 0x20..0x7E, one byte per column, LSB at the top */

static const uint8_t font5x7[95][5] = {
    {0x00,0x00,0x00,0x00,0x00}, {0x00,0x00,0x5F,0x00,0x00}, {0x00,0x07,0x00,0x07,0x00}, {0x14,0x7F,0x14,0x7F,0x14},
    {0x24,0x2A,0x7F,0x2A,0x12}, {0x23,0x13,0x08,0x64,0x62}, {0x36,0x49,0x55,0x22,0x50}, {0x00,0x05,0x03,0x00,0x00},
    {0x00,0x1C,0x22,0x41,0x00}, {0x00,0x41,0x22,0x1C,0x00}, {0x08,0x2A,0x1C,0x2A,0x08}, {0x08,0x08,0x3E,0x08,0x08},
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    {0x00,0x00,0x7F,0x00,0x00}, {0x00,0x41,0x36,0x08,0x00}, {0x10,0x08,0x08,0x10,0x08},
};

/* ------------------------------------------------------------ drawing */

bool oled_init(void) {
    const gpio_config_t config = {
        .pin_bit_mask = (UINT64_C(1) << OLED_SDA_GPIO) | (UINT64_C(1) << OLED_SCL_GPIO),
        .mode = GPIO_MODE_INPUT_OUTPUT_OD,
        .pull_up_en = GPIO_PULLUP_ENABLE,                        /* the module has its own pull-ups as a rule; these do no harm */
        .pull_down_en = GPIO_PULLDOWN_DISABLE,
        .intr_type = GPIO_INTR_DISABLE,
    };
    if (gpio_config(&config) != ESP_OK) return false;
    sda(1);
    scl(1);
    esp_rom_delay_us(100);
    for (int i = 0; i < 9; ++i) { scl(0); scl(1); }              /* free a slave stuck in a byte after a reset */
    i2c_stop();
    static const uint8_t init[] = {
        0xAE,                                                    /* display off */
        0xD5, 0x80, 0xA8, 0x3F, 0xD3, 0x00, 0x40,                /* clock, 64 lines, no offset, start line 0 */
        0x8D, 0x14,                                              /* charge pump on */
        0x20, 0x02,                                              /* SSD1306 page addressing, the only mode the SH1106 has */
        0xA1, 0xC8,                                              /* segment remap, COM scan down: pins at the top */
        0xDA, 0x12, 0x81, 0xCF, 0xD9, 0xF1, 0xDB, 0x40,          /* COM pins, contrast, precharge, VCOMH */
        0xA4, 0xA6, 0x2E, 0xAF,                                  /* RAM content, normal video, no scroll, display on */
    };
    const uint8_t probe[] = {0x3C, 0x3D};
    for (size_t i = 0; i < sizeof(probe); ++i) {
        addr = probe[i];
        if (cmds(init, sizeof(init))) break;
        addr = 0;
    }
    if (!addr) return false;
    oled_flush(NULL);
    return true;
}

void oled_clear(oled_fb_t *f) { memset(f->px, 0, sizeof(f->px)); }

static void pixel(oled_fb_t *f, int x, int y) {
    if (x >= 0 && x < OLED_W && y >= 0 && y < OLED_H) f->px[(y >> 3) * OLED_W + x] |= 1u << (y & 7);
}

void oled_text(oled_fb_t *f, int x, int page, int scale, const char *s) {
    const int y0 = page * 8;
    for (; *s; ++s, x += 6 * scale) {
        const uint8_t ch = (uint8_t)*s;
        const uint8_t *g = font5x7[ch >= 0x20 && ch <= 0x7E ? ch - 0x20 : '?' - 0x20];
        for (int col = 0; col < 5; ++col)
            for (int row = 0; row < 7; ++row)
                if (g[col] >> row & 1)
                    for (int dx = 0; dx < scale; ++dx)
                        for (int dy = 0; dy < scale; ++dy) pixel(f, x + col * scale + dx, y0 + row * scale + dy);
    }
}

void oled_invert(oled_fb_t *f, int x0, int x1, int page) {
    if (page < 0 || page >= OLED_H / 8) return;
    for (int x = x0 < 0 ? 0 : x0; x < x1 && x < OLED_W; ++x) f->px[page * OLED_W + x] ^= 0xFF;
}

void oled_hseg(oled_fb_t *f, int x0, int x1, int y) {
    for (int x = x0; x < x1; ++x) pixel(f, x, y);
}

void oled_hline(oled_fb_t *f, int y) { oled_hseg(f, 0, OLED_W, y); }

void oled_flush(const oled_fb_t *f) {                           /* NULL: blank */
    if (!addr) return;
    for (int page = 0; page < OLED_H / 8; ++page) {              /* page by page: the SH1106 does not advance to the next page */
        const int col = f ? OLED_COL_OFFSET : 0, n = f ? OLED_W : OLED_W + 2 * OLED_COL_OFFSET;
        const uint8_t at[] = {(uint8_t)(0xB0 | page), (uint8_t)(col & 15), (uint8_t)(0x10 | col >> 4)};
        cmds(at, sizeof(at));
        i2c_start();
        if (i2c_byte(addr << 1) && i2c_byte(0x40))               /* control byte: display data follows */
            for (int i = 0; i < n; ++i) i2c_byte(f ? f->px[page * OLED_W + i] : 0);
        i2c_stop();
    }
}
